## examples/cam/main/Kconfig.projbuild
```kconfig
menu "OV3660 camera test suite"
choice CAM_TEST_CASE
    prompt "Test case"
    default CAM_TEST_CAM01
    config CAM_TEST_CAM01
        bool "CAM-01 resolution and frame rate"
    config CAM_TEST_CAM02
        bool "CAM-02 pixel format and bandwidth"
    config CAM_TEST_CAM03
        bool "CAM-03 JPEG decode and PPA"
    config CAM_TEST_CAM04
        bool "CAM-04 camera to display handoff"
    config CAM_TEST_CAM05
        bool "CAM-05 illumination and AE recovery"
    config CAM_TEST_CAM06
        bool "CAM-06 motion, drops and recovery"
endchoice

config CAM_RUN_SECONDS
    int "Seconds per measurement"
    range 1 60
    default 5

config CAM_STRESS_LEVEL
    int "CPU background stress level (0..10)"
    range 0 10
    default 0
    help
        Each core runs a bounded busy slice at task priority 2. Level 10 targets
        about 90 percent busy time while still yielding often enough for the
        camera/LCD tasks, idle task and task watchdog. The result line reports
        the measured stress busy percentage for each core.

config CAM_STRESS_PERIOD_US
    int "Stress period (us)"
    range 1000 20000
    default 10000

config CAM_BUFFER_COUNT
    int "V4L2 MMAP buffer count"
    range 2 6
    default 4
endmenu
```

## examples/cam/sdkconfig.defaults
```kconfig
CONFIG_IDF_TARGET="esp32s31"
CONFIG_ESPTOOLPY_FLASHSIZE_16MB=y
CONFIG_CAMERA_OV3660=y
CONFIG_CAMERA_OV3660_AUTO_DETECT_DVP_INTERFACE_SENSOR=y
CONFIG_CAMERA_OV3660_DVP_JPEG_1280X720_12FPS=y
CONFIG_CAMERA_OV3660_DVP_RGB565_BE_240X240_24FPS=y
CONFIG_CAMERA_OV3660_DVP_RGB565_BE_640X480_10FPS=y
CONFIG_CAMERA_OV3660_DVP_YUV422_YUYV_240X240_24FPS=y
CONFIG_CAMERA_OV3660_DVP_YUV422_YUYV_640X480_10FPS=y
CONFIG_CAMERA_OV3660_DVP_DEFAULT_FMT_YUV422_YUYV_640X480_10FPS=y
CONFIG_COMPILER_OPTIMIZATION_PERF=y
CONFIG_ESP_DEFAULT_CPU_FREQ_MHZ_240=y
CONFIG_SPIRAM=y
CONFIG_SPIRAM_MODE_OCT=y
CONFIG_SPIRAM_SPEED_200M=y
CONFIG_FREERTOS_HZ=1000
CONFIG_ESP_SYSTEM_PANIC_PRINT_REBOOT=y
CONFIG_PARTITION_TABLE_CUSTOM=y
CONFIG_PARTITION_TABLE_CUSTOM_FILENAME="partitions.csv"
```

## examples/codec/aud/aud01_clock/main/Kconfig.projbuild
```kconfig
menu "AUD-01 I2S clock baseline"

config AUD01_SAMPLE_RATE
    int "Sample rate (Hz)"
    range 8000 192000
    default 48000
config AUD01_BLOCK_FRAMES
    int "Application block size (frames)"
    range 1 4096
    default 480
config AUD01_TEST_SECONDS
    int "Test duration (seconds)"
    range 1 86400
    default 30

endmenu
```

## examples/codec/aud/aud02_capture/main/Kconfig.projbuild
```kconfig
menu "AUD-02 dual microphone capture"

config AUD02_SAMPLE_RATE
    int "Sample rate (Hz)"
    range 8000 192000
    default 48000
config AUD02_BLOCK_FRAMES
    int "Application block size (frames)"
    range 16 4096
    default 480
config AUD02_TEST_SECONDS
    int "Test duration (seconds)"
    range 1 86400
    default 30
config AUD02_MIC_GAIN_DB
    int "Microphone PGA gain (dB)"
    range 0 42
    default 20

endmenu
```

## examples/codec/aud/aud02_capture/sdkconfig.defaults
```kconfig
CONFIG_IDF_TARGET="esp32s31"
CONFIG_ESPTOOLPY_FLASHSIZE_16MB=y
CONFIG_SPIRAM=y
CONFIG_SPIRAM_MODE_OCT=y
CONFIG_ESP_DEFAULT_CPU_FREQ_MHZ_240=y
CONFIG_FREERTOS_HZ=1000
CONFIG_COMPILER_OPTIMIZATION_PERF=y
CONFIG_AUD02_SAMPLE_RATE=48000
CONFIG_AUD02_BLOCK_FRAMES=480
CONFIG_AUD02_TEST_SECONDS=30
CONFIG_AUD02_MIC_GAIN_DB=20
```

## examples/codec/aud/aud03_playback/main/Kconfig.projbuild
```kconfig
menu "AUD-03 continuous playback"

config AUD03_SAMPLE_RATE
    int "Sample rate (Hz)"
    range 8000 96000
    default 48000
config AUD03_BLOCK_FRAMES
    int "Application block size (frames)"
    range 16 4096
    default 480
config AUD03_TEST_SECONDS
    int "Test duration (seconds)"
    range 1 86400
    default 30
config AUD03_VOLUME
    int "Codec output volume"
    range 0 100
    default 18

endmenu
```

## examples/codec/aud/aud03_playback/sdkconfig.defaults
```kconfig
CONFIG_IDF_TARGET="esp32s31"
CONFIG_ESPTOOLPY_FLASHSIZE_16MB=y
CONFIG_SPIRAM=y
CONFIG_SPIRAM_MODE_OCT=y
CONFIG_ESP_DEFAULT_CPU_FREQ_MHZ_240=y
CONFIG_FREERTOS_HZ=1000
CONFIG_COMPILER_OPTIMIZATION_PERF=y
CONFIG_AUD03_SAMPLE_RATE=48000
CONFIG_AUD03_BLOCK_FRAMES=480
CONFIG_AUD03_TEST_SECONDS=30
CONFIG_AUD03_VOLUME=18
```

## examples/codec/aud/aud04_full_duplex/main/Kconfig.projbuild
```kconfig
menu "AUD-04 full duplex"

config AUD04_SAMPLE_RATE
    int "Sample rate (Hz)"
    range 8000 96000
    default 48000
config AUD04_BLOCK_FRAMES
    int "Application block size (frames)"
    range 16 4096
    default 480
config AUD04_TEST_SECONDS
    int "Test duration (seconds)"
    range 1 86400
    default 30
config AUD04_VOLUME
    int "Codec output volume"
    range 0 100
    default 18

endmenu
```

## examples/codec/aud/aud05_recovery/main/Kconfig.projbuild
```kconfig
menu "AUD-05 clock reconfiguration and recovery"

config AUD05_SAMPLE_RATE
    int "Primary sample rate (Hz)"
    range 8000 96000
    default 48000
config AUD05_ALT_RATE
    int "Alternate sample rate (Hz)"
    range 8000 96000
    default 16000
config AUD05_BLOCK_FRAMES
    int "Application block size (frames)"
    range 16 4096
    default 480
config AUD05_TEST_SECONDS
    int "Time at each rate (seconds)"
    range 1 3600
    default 3
config AUD05_RECOVERY_CYCLES
    int "Number of close/reopen cycles"
    range 1 10000
    default 10
config AUD05_VOLUME
    int "Codec output volume"
    range 0 100
    default 12

endmenu
```

## examples/codec/aud/aud05_recovery/sdkconfig.defaults
```kconfig
CONFIG_IDF_TARGET="esp32s31"
CONFIG_ESPTOOLPY_FLASHSIZE_16MB=y
CONFIG_SPIRAM=y
CONFIG_SPIRAM_MODE_OCT=y
CONFIG_ESP_DEFAULT_CPU_FREQ_MHZ_240=y
CONFIG_FREERTOS_HZ=1000
CONFIG_COMPILER_OPTIMIZATION_PERF=y
CONFIG_AUD05_SAMPLE_RATE=48000
CONFIG_AUD05_ALT_RATE=16000
CONFIG_AUD05_BLOCK_FRAMES=480
CONFIG_AUD05_TEST_SECONDS=3
CONFIG_AUD05_RECOVERY_CYCLES=10
CONFIG_AUD05_VOLUME=12
```

## examples/lcd/lcd_03_lvgl_load/sdkconfig.defaults
```kconfig
CONFIG_IDF_TARGET="esp32s31"
CONFIG_SPIRAM=y
CONFIG_SPIRAM_SPEED_250M=y
CONFIG_SPIRAM_XIP_FROM_PSRAM=y
CONFIG_LV_COLOR_DEPTH_16=y
CONFIG_FREERTOS_USE_TRACE_FACILITY=y
CONFIG_FREERTOS_GENERATE_RUN_TIME_STATS=y
CONFIG_FREERTOS_RUN_TIME_COUNTER_TYPE_U64=y
CONFIG_LCD_PERF_CPU_LOAD_STATS=y
CONFIG_LCD_TEST_ID=3
CONFIG_LCD_PERF_WIDGET_COUNT=48
CONFIG_LCD_PERF_ANIM_STEP=7
```

## examples/lcd/lcd_04_tearing_stability/sdkconfig.defaults
```kconfig
CONFIG_IDF_TARGET="esp32s31"
CONFIG_SPIRAM=y
CONFIG_SPIRAM_SPEED_250M=y
CONFIG_SPIRAM_XIP_FROM_PSRAM=y
CONFIG_LV_COLOR_DEPTH_16=y
CONFIG_LCD_TEST_ID=4
CONFIG_LCD_PERF_BUFFER_MODE_DOUBLE=y
CONFIG_LCD_PERF_TEARING_LAYERS=8
CONFIG_LCD_PERF_TIMER_PERIOD_MS=8
```

## examples/lcd/lcd_05_chinese_text/main/Kconfig.projbuild
```kconfig
menu "LCD/LVGL Performance Common"
    config LCD_TEST_ID
        int "LCD test number (fixed for this demo)"
        range 5 5
        default 5
    config LCD_PERF_TIMER_PERIOD_MS
        int "Synthetic load timer period (ms)"
        range 1 1000
        default 16
    config LCD_PERF_ANIM_STEP
        int "Animation step"
        range 1 360
        default 7
    config LCD_PERF_BUFFER_OBJECTS
        int "LCD-02 moving objects"
        range 1 256
        default 24
    config LCD_PERF_WIDGET_COUNT
        int "LCD-03 widget count"
        range 1 256
        default 48
    config LCD_PERF_TEARING_LAYERS
        int "LCD-04 alpha layers"
        range 1 32
        default 8
    config LCD_PERF_TEXT_LENGTH
        int "LCD-05 generated UTF-8 text length"
        range 64 4096
        default 1800
    config LCD_PERF_TEXT_SCROLL_PX
        int "LCD-05 scroll pixels per tick"
        range 1 100
        default 4
    choice LCD_PERF_JPEG_ROTATE
        prompt "LCD-06 JPEG rotation"
        default LCD_PERF_JPEG_ROTATE_0
        config LCD_PERF_JPEG_ROTATE_0
            bool "0 degrees"
        config LCD_PERF_JPEG_ROTATE_90
            bool "90 degrees"
        config LCD_PERF_JPEG_ROTATE_180
            bool "180 degrees"
        config LCD_PERF_JPEG_ROTATE_270
            bool "270 degrees"
    endchoice
    config LCD_PERF_JPEG_ROTATE
        int
        default 0 if LCD_PERF_JPEG_ROTATE_0
        default 1 if LCD_PERF_JPEG_ROTATE_90
        default 2 if LCD_PERF_JPEG_ROTATE_180
        default 3 if LCD_PERF_JPEG_ROTATE_270
    config LCD_PERF_JPEG_ROTATE_STEP
        int "LCD-06 UI rotation step (0.1 degree)"
        range 0 360
        default 15
    config LCD_PERF_JPEG_SCALE
        int "LCD-06 JPEG square scale (0 disables)"
        range 0 800
        default 0
    config LCD_PERF_JPEG_REDECODE
        bool "LCD-06 continuously re-decode JPEG"
        default n
    config LCD_PERF_JPEG_REDECODE_PERIOD_MS
        int "JPEG re-decode period (ms)"
        range 1 60000
        default 1000
    config LCD_PERF_PCLK_HZ
        int "RGB PCLK frequency (Hz)"
        range 6000000 30000000
        default 18000000
    config LCD_PERF_HSYNC_PULSE
        int "HSYNC pulse width"
        range 1 128
        default 40
    config LCD_PERF_HBP
        int "HSYNC back porch"
        range 1 256
        default 40
    config LCD_PERF_HFP
        int "HSYNC front porch"
        range 1 256
        default 48
    config LCD_PERF_VSYNC_PULSE
        int "VSYNC pulse width"
        range 1 128
        default 23
    config LCD_PERF_VBP
        int "VSYNC back porch"
        range 1 256
        default 32
    config LCD_PERF_VFP
        int "VSYNC front porch"
        range 1 256
        default 13
    choice LCD_PERF_BUFFER_MODE
        prompt "RGB frame buffer mode"
        default LCD_PERF_BUFFER_MODE_SINGLE
        config LCD_PERF_BUFFER_MODE_SINGLE
            bool "Single frame buffer + partial LVGL"
        config LCD_PERF_BUFFER_MODE_DOUBLE
            bool "Double frame buffer + direct LVGL"
        config LCD_PERF_BUFFER_MODE_BOUNCE
            bool "Single frame buffer + bounce buffers"
    endchoice
    config LCD_PERF_DRAW_BUF_LINES
        int "LVGL partial draw buffer lines"
        range 2 480
        default 40
    config LCD_PERF_DRAW_BUF_DOUBLE
        bool "Use two LVGL partial draw buffers"
        default n
    config LCD_PERF_BOUNCE_LINES
        int "Bounce buffer lines"
        range 2 120
        default 20
        depends on LCD_PERF_BUFFER_MODE_BOUNCE
    config LCD_PERF_LOG_PERIOD_MS
        int "Performance log period (ms)"
        range 1000 60000
        default 5000
endmenu
```

## examples/lcd/lcd_05_chinese_text/sdkconfig.defaults
```kconfig
CONFIG_IDF_TARGET="esp32s31"
CONFIG_SPIRAM=y
CONFIG_SPIRAM_SPEED_250M=y
CONFIG_SPIRAM_XIP_FROM_PSRAM=y
CONFIG_LV_COLOR_DEPTH_16=y
CONFIG_LV_FONT_SOURCE_HAN_SANS_SC_16_CJK=y
CONFIG_LV_FONT_DEFAULT_SOURCE_HAN_SANS_SC_16_CJK=y
CONFIG_LCD_TEST_ID=5
CONFIG_LCD_PERF_TEXT_LENGTH=1800
CONFIG_LCD_PERF_TEXT_SCROLL_PX=4
```

## examples/lcd/lcd_06_jpeg_ui/sdkconfig.defaults
```kconfig
CONFIG_IDF_TARGET="esp32s31"
CONFIG_SPIRAM=y
CONFIG_SPIRAM_SPEED_250M=y
CONFIG_SPIRAM_XIP_FROM_PSRAM=y
CONFIG_LV_COLOR_DEPTH_16=y
CONFIG_LCD_TEST_ID=6
CONFIG_LCD_PERF_JPEG_SCALE=0
CONFIG_LCD_PERF_JPEG_ROTATE_0=y
```

## examples/sys/sys02/sys02D/main/Kconfig.projbuild
```kconfig
menu "SYS-02D dual-core memory parallel benchmark"

config SYS02D_SCENARIO
    int "Parallel memory scenario"
    range 1 5
    default 2
    help
        1: Core0 Flash read, Core1 PSRAM->PSRAM
        2: Core0 SRAM->SRAM, Core1 SRAM->SRAM
        3: Core0 PSRAM->PSRAM, Core1 PSRAM->PSRAM
        4: Core0 PSRAM->PSRAM, Core1 SRAM->SRAM
        5: Core0 SRAM->PSRAM, Core1 SRAM->PSRAM

config SYS02D_BUFFER_KIB
    int "Per-worker copy buffer size (KiB)"
    range 4 128
    default 64
    help
        Keep this equal to SYS-02B for a directly comparable baseline. D2
        allocates four Internal RAM buffers, so 128 KiB is the safe maximum.

config SYS02D_DURATION_MS
    int "Measurement duration (ms)"
    range 500 10000
    default 2000

config SYS02D_COPIES_PER_TIME_CHECK
    int "Copies between time checks"
    range 1 256
    default 64
    help
        Keep 64 to match SYS-02B and amortize esp_timer_get_time overhead.

endmenu
```

## examples/sys/sys02/sys02E/sdkconfig.defaults
```kconfig
CONFIG_ESPTOOLPY_FLASHSIZE_16MB=y
CONFIG_PARTITION_TABLE_CUSTOM=y
CONFIG_PARTITION_TABLE_CUSTOM_FILENAME="partitions.csv"
CONFIG_SPIRAM=y
CONFIG_SPIRAM_USE_MALLOC=y
CONFIG_ESP_SYSTEM_PANIC_PRINT_REBOOT=y
```

## examples/sys/sys02/sys02F/main/Kconfig.projbuild
```kconfig
menu "SYS-02F long stress"

config SYS02F_DURATION_MINUTES
    int "Stress duration (minutes)"
    range 1 1440
    default 10
    help
        Use 1440 for the formal 24-hour SYS-02F run. A shorter default keeps
        the first smoke test manageable.

config SYS02F_LOG_INTERVAL_SEC
    int "Log interval (seconds)"
    range 1 3600
    default 60

endmenu
```

## examples/sys/sys02/sys02F/sdkconfig.defaults
```kconfig
CONFIG_ESPTOOLPY_FLASHSIZE_16MB=y
CONFIG_PARTITION_TABLE_CUSTOM=y
CONFIG_PARTITION_TABLE_CUSTOM_FILENAME="partitions.csv"
CONFIG_SPIRAM=y
CONFIG_SPIRAM_USE_MALLOC=y
CONFIG_ESP_SYSTEM_PANIC_PRINT_REBOOT=y
CONFIG_FREERTOS_GENERATE_RUN_TIME_STATS=y
CONFIG_FREERTOS_RUN_TIME_STATS_USING_ESP_TIMER=y
```

## examples/sys/sys03/sys03c/main/Kconfig.projbuild
```kconfig
menu "SYS-03C IPC benchmark"

config SYS03C_TX_PERIOD_US
    int "TX message period (us)"
    range 0 1000000
    default 1000
    help
        Interval between queue messages.  1000 us is 1 kmsg/s.  Set to 0
        to send as fast as possible (the sender yields between attempts).

config SYS03C_QUEUE_LENGTH
    int "Queue length (messages)"
    range 2 4096
    default 64
    help
        Number of messages that can be buffered before xQueueSend fails.

endmenu
```

## examples/sys/sys03/sys03e/sdkconfig.defaults
```kconfig
CONFIG_ESP_COREDUMP_ENABLE_TO_FLASH=y
CONFIG_PARTITION_TABLE_CUSTOM=y
CONFIG_PARTITION_TABLE_CUSTOM_FILENAME="partitions.csv"
CONFIG_IDF_TARGET="esp32s31"
CONFIG_ESPTOOLPY_FLASHSIZE_16MB=y
```

## examples/touch/tp03_concurrent_load/main/Kconfig.projbuild
```kconfig
menu "TP-03 concurrent load"

config TP03_STRESS_LEVEL
    int "CPU stress level (0-100%)"
    range 0 100
    default 50
    help
        Controls the CPU duty cycle on both cores. 0 disables the burn;
        100 targets about 95% busy time while preserving a small idle slice
        for the task watchdog. Increase this value between runs to find the
        touch-to-frame latency knee.

endmenu
```

## examples/touch/tp03_concurrent_load/sdkconfig.defaults
```kconfig
CONFIG_IDF_TARGET="esp32s31"
CONFIG_SPIRAM=y
CONFIG_SPIRAM_SPEED_250M=y
CONFIG_SPIRAM_XIP_FROM_PSRAM=y
CONFIG_FREERTOS_GENERATE_RUN_TIME_STATS=y
CONFIG_IDF_TARGET="esp32s31"
CONFIG_ESPTOOLPY_FLASHMODE_QIO=y
CONFIG_ESPTOOLPY_FLASHSIZE_16MB=y
CONFIG_PARTITION_TABLE_CUSTOM=y
CONFIG_COMPILER_OPTIMIZATION_PERF=y
CONFIG_SPIRAM=y
CONFIG_SPIRAM_MODE_OCT=y
CONFIG_SPIRAM_FETCH_INSTRUCTIONS=y
CONFIG_SPIRAM_RODATA=y
CONFIG_SPIRAM_SPEED_200M=y
CONFIG_SPIRAM_SPEED=200
CONFIG_ESP_DEFAULT_CPU_FREQ_MHZ_240=y
CONFIG_FREERTOS_HZ=1000
CONFIG_BSP_LCD_RGB_BUFFER_NUMS=2
CONFIG_BSP_LCD_RGB_BOUNCE_BUFFER_MODE=y
CONFIG_BSP_LCD_RGB_BOUNCE_BUFFER_HEIGHT=20
# CONFIG_BSP_DISPLAY_LVGL_AVOID_TEAR is not set
# CONFIG_BSP_DISPLAY_LVGL_DIRECT_MODE is not set
CONFIG_CODEC_I2C_BACKWARD_COMPATIBLE=n
CONFIG_LV_CONF_SKIP=y
CONFIG_LV_BUILD_EXAMPLES=n
CONFIG_LV_USE_CLIB_MALLOC=y
CONFIG_LV_USE_CLIB_SPRINTF=y
CONFIG_LV_USE_CLIB_STRING=y
CONFIG_ESP_LCD_TOUCH_MAX_POINTS=5
CONFIG_TP03_STRESS_LEVEL=50
```
